## Controller code esp-idf/esp32s3_hid_gamepad/sdkconfig.defaults
```kconfig
CONFIG_IDF_TARGET="esp32s3"
CONFIG_TINYUSB_ENABLED=y
CONFIG_TINYUSB_DEVICE_ENABLED=y
CONFIG_TINYUSB_HID_ENABLED=y
CONFIG_ESP_CONSOLE_USB_CDC=y
```

## Controller code esp-idf/pcal6416a_pure_emulator/main/Kconfig.projbuild
```kconfig
menu "PCAL6416A Pure Emulator Configuration"

config PCAL6416A_I2C_SDA
    int "I2C SDA GPIO"
    default 8
    help
        GPIO number for I2C SDA pin.

config PCAL6416A_I2C_SCL
    int "I2C SCL GPIO"
    default 9
    help
        GPIO number for I2C SCL pin.

config PCAL6416A_I2C_ADDR
    hex "I2C Slave Address"
    default 0x20
    help
        I2C slave address of the emulator.

config PCAL6416A_INT_PIN
    int "INT GPIO pin"
    default 10
    help
        GPIO number used for INT (active-low open-drain).

endmenu
```
